## CMakeLists.txt
```
#
# CMakeLists.txt - Zephyr demo application (ZDEMO), NUCLEO-F767ZI
#
# Author:  Sandesh Ghimire <sandesh@soccentric.com>
# Date:    2026-11-03
# SRS:     SRS-ZEPHYR-F767 (ZCON-001..003, ZGEN-001..007, ZLNK-001..004)
#
# Freestanding Zephyr application (ZCON-003): built against $ZEPHYR_BASE in
# the stm32-dev-zephyr container, without a west workspace.
#   scripts/build.sh [clean]
#

cmake_minimum_required(VERSION 3.20.0)

set(BOARD nucleo_f767zi)
set(DTC_OVERLAY_FILE "${CMAKE_CURRENT_SOURCE_DIR}/boards/nucleo_f767zi.overlay")

# --- Version and build metadata (ZGEN-002) ---------------------------------
file(STRINGS "${CMAKE_CURRENT_SOURCE_DIR}/VERSION" VERSION_LINES)
foreach(_line IN LISTS VERSION_LINES)
    if(_line MATCHES "^VERSION_MAJOR[ \t]*=[ \t]*([0-9]+)")
        set(APP_VERSION_MAJOR "${CMAKE_MATCH_1}")
    elseif(_line MATCHES "^VERSION_MINOR[ \t]*=[ \t]*([0-9]+)")
        set(APP_VERSION_MINOR "${CMAKE_MATCH_1}")
    elseif(_line MATCHES "^PATCHLEVEL[ \t]*=[ \t]*([0-9]+)")
        set(APP_VERSION_PATCH "${CMAKE_MATCH_1}")
    endif()
endforeach()
if(NOT DEFINED APP_VERSION_MAJOR)
    set(APP_VERSION_MAJOR 0)
endif()
if(NOT DEFINED APP_VERSION_MINOR)
    set(APP_VERSION_MINOR 1)
endif()
if(NOT DEFINED APP_VERSION_PATCH)
    set(APP_VERSION_PATCH 0)
endif()
set(APP_VERSION "${APP_VERSION_MAJOR}.${APP_VERSION_MINOR}.${APP_VERSION_PATCH}")
set(APP_FIRMWARE_NAME "zephyr-app")

execute_process(COMMAND git -C "${CMAKE_CURRENT_SOURCE_DIR}" rev-parse --short=12 HEAD
    OUTPUT_VARIABLE APP_GIT_COMMIT OUTPUT_STRIP_TRAILING_WHITESPACE ERROR_QUIET)
execute_process(COMMAND git -C "${CMAKE_CURRENT_SOURCE_DIR}" rev-parse HEAD
    OUTPUT_VARIABLE APP_GIT_COMMIT_FULL OUTPUT_STRIP_TRAILING_WHITESPACE ERROR_QUIET)
if(NOT APP_GIT_COMMIT)
    set(APP_GIT_COMMIT "unknown")
    set(APP_GIT_COMMIT_FULL "")
else()
    execute_process(COMMAND git -C "${CMAKE_CURRENT_SOURCE_DIR}" status --porcelain
        OUTPUT_VARIABLE APP_GIT_DIRTY OUTPUT_STRIP_TRAILING_WHITESPACE ERROR_QUIET)
    if(APP_GIT_DIRTY)
        string(APPEND APP_GIT_COMMIT "-dirty")
    endif()
endif()
string(TIMESTAMP APP_BUILD_DATE "%Y-%m-%d %H:%M:%S" UTC)
string(TIMESTAMP APP_BUILD_TIMESTAMP "%s" UTC)

# The image's Zephyr tree has no .git (ZCON-002); its version is recorded in
# /opt/zephyrproject/VERSION by docker/Dockerfile.
if(NOT DEFINED BUILD_VERSION AND EXISTS "$ENV{ZEPHYR_BASE}/../VERSION")
    file(STRINGS "$ENV{ZEPHYR_BASE}/../VERSION" BUILD_VERSION LIMIT_COUNT 1)
endif()

find_package(Zephyr REQUIRED HINTS $ENV{ZEPHYR_BASE})
project(zephyr_app LANGUAGES C)

target_compile_definitions(app PRIVATE
    APP_VERSION_STR="${APP_VERSION}"
    APP_FIRMWARE_NAME="${APP_FIRMWARE_NAME}"
    APP_GIT_COMMIT="${APP_GIT_COMMIT}"
    APP_BUILD_DATE="${APP_BUILD_DATE}"
    APP_BUILD_TIMESTAMP=${APP_BUILD_TIMESTAMP}
    APP_FLATCC_HEAP_SIZE=12288
    FLATCC_ALLOC=app_flatcc_alloc
    FLATCC_FREE=app_flatcc_free
    FLATCC_REALLOC=app_flatcc_realloc
    FLATCC_CALLOC=app_flatcc_calloc
    FLATCC_ALIGNED_ALLOC=app_flatcc_aligned_alloc
    FLATCC_ALIGNED_FREE=app_flatcc_aligned_free
    FLATCC_EMITTER_ALLOC=app_flatcc_alloc
    FLATCC_EMITTER_FREE=app_flatcc_free)

# The generated flatcc headers and runtime see the fixed-arena allocator
# through this force-include (ZRT-004).
target_compile_options(app PRIVATE
    -include "${CMAKE_CURRENT_SOURCE_DIR}/src/comms/flatcc_port.h")

target_include_directories(app PRIVATE
    "${CMAKE_CURRENT_SOURCE_DIR}/src"
    "${CMAKE_BINARY_DIR}/generated"
    "${CMAKE_CURRENT_SOURCE_DIR}/src/generated"
    "${CMAKE_CURRENT_SOURCE_DIR}/third_party/flatcc/include")

# The generated flatcc headers use compact macro formatting that trips
# -Wmisleading-indentation in the one translation unit that includes them.
set_source_files_properties(src/comms/comms.c PROPERTIES
    COMPILE_OPTIONS "-Wno-misleading-indentation")

target_sources(app PRIVATE
    # Application entry point and shared configuration
    src/main.c

    # Board-level I/O
    src/board/button.c
    src/board/led.c
    src/board/led_pattern.c

    # Bootloader contract and metadata
    src/boot/flash_confirm.c
    src/boot/handover.c
    src/boot/identity.c

    # HWLINK communication stack
    src/comms/comms.c
    src/comms/flatcc_port.c
    src/comms/hwlink.c
    src/comms/uart_hwlink.c

    # System services and supervision
    src/system/debug_log.c
    src/system/fatal.c
    src/system/health.c
    src/system/iwdg.c
    src/system/reset_cause.c)

# flatcc 0.6.1 runtime as released.  Only builder, verifier and emitter are
# linked; JSON support is not used.
set(FLATCC_ROOT "${CMAKE_CURRENT_SOURCE_DIR}/third_party/flatcc")
target_sources(app PRIVATE
    "${FLATCC_ROOT}/src/runtime/builder.c"
    "${FLATCC_ROOT}/src/runtime/verifier.c"
    "${FLATCC_ROOT}/src/runtime/emitter.c"
    "${FLATCC_ROOT}/src/runtime/refmap.c")

# --- HWLINK schema (ZLNK-001) ------------------------------------------------
# The generated C headers are committed so the container does not need a host
# flatcc compiler.  When flatcc is available, regenerate them as part of the
# build; the build-tree copy takes precedence over src/generated.
find_program(FLATCC flatcc)
if(FLATCC)
    set(FLATCC_OUT "${CMAKE_BINARY_DIR}/generated")
    add_custom_command(
        OUTPUT
            "${FLATCC_OUT}/hwlink_reader.h"
            "${FLATCC_OUT}/hwlink_builder.h"
            "${FLATCC_OUT}/hwlink_verifier.h"
            "${FLATCC_OUT}/flatbuffers_common_reader.h"
            "${FLATCC_OUT}/flatbuffers_common_builder.h"
        COMMAND ${CMAKE_COMMAND} -E make_directory "${FLATCC_OUT}"
        COMMAND ${FLATCC} -a -o "${FLATCC_OUT}" "${CMAKE_CURRENT_SOURCE_DIR}/protocol/hwlink.fbs"
        DEPENDS "${CMAKE_CURRENT_SOURCE_DIR}/protocol/hwlink.fbs"
        COMMENT "Generating HWLINK FlatBuffers C headers")
    add_custom_target(hwlink_schema DEPENDS
        "${FLATCC_OUT}/hwlink_reader.h"
        "${FLATCC_OUT}/hwlink_builder.h"
        "${FLATCC_OUT}/hwlink_verifier.h")
    add_dependencies(app hwlink_schema)
endif()

# --- Build products (ZGEN-001, ZGEN-002) -------------------------------------
find_package(Python3 COMPONENTS Interpreter REQUIRED)
get_filename_component(_compiler_dir "${CMAKE_C_COMPILER}" DIRECTORY)
find_program(SIZE_TOOL NAMES arm-zephyr-eabi-size arm-none-eabi-size
    HINTS "${_compiler_dir}" REQUIRED)

add_custom_target(zephyr_app_outputs ALL
    COMMAND ${CMAKE_COMMAND} -E copy
            "${CMAKE_BINARY_DIR}/zephyr/zephyr.elf"
            "${CMAKE_BINARY_DIR}/zephyr-app.elf"
    COMMAND ${CMAKE_COMMAND} -E copy
            "${CMAKE_BINARY_DIR}/zephyr/zephyr.bin"
            "${CMAKE_BINARY_DIR}/zephyr-app.bin"
    COMMAND ${CMAKE_COMMAND} -E copy
            "${CMAKE_BINARY_DIR}/zephyr/zephyr.hex"
            "${CMAKE_BINARY_DIR}/zephyr-app.hex"
    COMMAND ${CMAKE_COMMAND} -E copy
            "${CMAKE_BINARY_DIR}/zephyr/zephyr.map"
            "${CMAKE_BINARY_DIR}/zephyr-app.map"
    COMMAND ${Python3_EXECUTABLE} "${CMAKE_CURRENT_SOURCE_DIR}/scripts/mkimage.py"
            --input "${CMAKE_BINARY_DIR}/zephyr-app.bin"
            --output "${CMAKE_BINARY_DIR}/zephyr-app.img"
            --version "${APP_VERSION}"
            --commit "${APP_GIT_COMMIT_FULL}"
            --timestamp "${APP_BUILD_TIMESTAMP}"
            --name "${APP_FIRMWARE_NAME}"
    COMMAND ${Python3_EXECUTABLE} "${CMAKE_CURRENT_SOURCE_DIR}/scripts/check_footprint.py"
            --size-tool "${SIZE_TOOL}"
            --max-flash 131072
            --max-ram 65536
            "${CMAKE_BINARY_DIR}/zephyr-app.elf"
    DEPENDS zephyr_final
    BYPRODUCTS
        "${CMAKE_BINARY_DIR}/zephyr-app.elf"
        "${CMAKE_BINARY_DIR}/zephyr-app.bin"
        "${CMAKE_BINARY_DIR}/zephyr-app.hex"
        "${CMAKE_BINARY_DIR}/zephyr-app.map"
        "${CMAKE_BINARY_DIR}/zephyr-app.img"
    COMMENT "Copying zephyr-app.* and generating the BOOT image file")

# --- Static analysis (ZDNFR-004) ---------------------------------------------
# clang-tidy reuses the compile flags this very configure step produced, so
# it must run from a configured build tree:  make lint / make lint-strict.
# The tool is optional: a normal firmware build must still configure on a host
# that has no clang-tidy, and only the lint target then reports the missing
# dependency.
find_program(CLANG_TIDY clang-tidy)
option(APP_LINT_STRICT "Treat any clang-tidy finding as an error (lint-strict)" OFF)
if(APP_LINT_STRICT)
    set(APP_LINT_FLAGS --warnings-as-errors=*)
else()
    set(APP_LINT_FLAGS)
endif()

# Hand-written sources only; generated headers and the vendored flatcc runtime
# are not linted.
set(APP_LINT_SOURCES
    "${CMAKE_CURRENT_SOURCE_DIR}/src/main.c"
    "${CMAKE_CURRENT_SOURCE_DIR}/src/board/button.c"
    "${CMAKE_CURRENT_SOURCE_DIR}/src/board/led.c"
    "${CMAKE_CURRENT_SOURCE_DIR}/src/board/led_pattern.c"
    "${CMAKE_CURRENT_SOURCE_DIR}/src/boot/flash_confirm.c"
    "${CMAKE_CURRENT_SOURCE_DIR}/src/boot/handover.c"
    "${CMAKE_CURRENT_SOURCE_DIR}/src/boot/identity.c"
    "${CMAKE_CURRENT_SOURCE_DIR}/src/comms/comms.c"
    "${CMAKE_CURRENT_SOURCE_DIR}/src/comms/flatcc_port.c"
    "${CMAKE_CURRENT_SOURCE_DIR}/src/comms/hwlink.c"
    "${CMAKE_CURRENT_SOURCE_DIR}/src/comms/uart_hwlink.c"
    "${CMAKE_CURRENT_SOURCE_DIR}/src/system/debug_log.c"
    "${CMAKE_CURRENT_SOURCE_DIR}/src/system/fatal.c"
    "${CMAKE_CURRENT_SOURCE_DIR}/src/system/health.c"
    "${CMAKE_CURRENT_SOURCE_DIR}/src/system/iwdg.c"
    "${CMAKE_CURRENT_SOURCE_DIR}/src/system/reset_cause.c")

if(CLANG_TIDY)
    add_custom_target(clang-tidy
        COMMAND ${Python3_EXECUTABLE}
                "${CMAKE_CURRENT_SOURCE_DIR}/scripts/clang_tidy.py"
                --build-dir "${CMAKE_BINARY_DIR}"
                --clang-tidy "${CLANG_TIDY}"
                --config "${CMAKE_CURRENT_SOURCE_DIR}/.clang-tidy"
                ${APP_LINT_FLAGS}
                ${APP_LINT_SOURCES}
        COMMENT "Running clang-tidy over the project sources"
        WORKING_DIRECTORY "${CMAKE_SOURCE_DIR}"
        VERBATIM)
else()
    add_custom_target(clang-tidy
        COMMAND ${CMAKE_COMMAND} -E echo
                "clang-tidy not found; install it to run make lint"
        COMMAND ${CMAKE_COMMAND} -E false
        COMMENT "clang-tidy is not available"
        VERBATIM)
endif()
```

## Kconfig
```
#
# Kconfig - ZDEMO application options
#
# Author:  Sandesh Ghimire <sandesh@soccentric.com>
# Date:    2026-11-03
# Target:  NUCLEO-F767ZI
# SRS:     ZFN-004 (HLT-004)
#

mainmenu "Zephyr demo application (ZDEMO)"

config ZDEMO_FAIL_HEALTH
	bool "Force the pending-slot health check to fail"
	default n
	help
	  Build the equivalent of the C demo's DEMO_FAIL_HEALTH option.  A
	  pending slot never confirms, LD3 fast-blinks, and the watchdog is
	  stopped after 10 s so BOOT can count a failed trial and roll back.

config ZDEMO_LOG_LEVEL
	int "Application log level (0=off, 1=error, 2=warn, 3=info, 4=debug)"
	range 0 4
	default 3
	help
	  Severity filter for the application's own log module.  The Zephyr
	  log backend still uses CONFIG_LOG_DEFAULT_LEVEL for kernel and driver
	  messages; this option only controls lines logged by src/.

config ZDEMO_WATCHDOG_TIMEOUT_MS
	int "IWDG timeout installed by the application (ms)"
	range 100 30000
	default 4000
	help
	  Timeout installed by app_wdt_init().  BOOT starts the IWDG with a
	  4 s window before hand-over, so the first application init must run
	  inside that window; afterwards the application may install this
	  value.  Keep it comfortably above the health thread's 100 ms feed
	  period and below the 10 s failed-trial stop.

source "Kconfig.zephyr"
```

## prj.conf
```kconfig
# prj.conf - ZDEMO Kconfig
# Author: Sandesh Ghimire <sandesh@soccentric.com>
# SRS:    SRS-ZEPHYR-F767

# ZBT-001: run from the bootloader slot at 0x0800C000, 976 KB.
CONFIG_USE_DT_CODE_PARTITION=n
CONFIG_FLASH_LOAD_OFFSET=0xC000
CONFIG_FLASH_LOAD_SIZE=0xF4000

# ZRT-002: k_event is used for health check-ins.
CONFIG_EVENTS=y

# ZRT-003: 1 kHz kernel tick.
CONFIG_SYS_CLOCK_TICKS_PER_SEC=1000

# ZGEN-003: caches on, as in the C demo.
CONFIG_CACHE_MANAGEMENT=y
CONFIG_ICACHE=y
CONFIG_DCACHE=y

# ZRT-006 / ZSAFE-004: MPU stack guards and assertions.
CONFIG_HW_STACK_PROTECTION=y
CONFIG_ASSERT=y

# ZGEN-006: no warnings.
CONFIG_COMPILER_WARNINGS_AS_ERRORS=y

# LEDs, button and USART3.
CONFIG_GPIO=y
CONFIG_SERIAL=y
CONFIG_UART_INTERRUPT_DRIVEN=y
CONFIG_UART_USE_RUNTIME_CONFIGURE=y

# ZCON-005: USART3 carries HWLINK only.  ZDBG-001: console and log output
# go to USART6 instead (chosen zephyr,console in the board overlay).
CONFIG_CONSOLE=y
CONFIG_UART_CONSOLE=y
CONFIG_PRINTK=y
CONFIG_BOOT_BANNER=n

# ZDBG-002: deferred logging, so no thread waits on the debug UART;
# ZDBG-003: src/system/debug_log.c prints the family line format.
CONFIG_LOG=y
CONFIG_LOG_MODE_DEFERRED=y
CONFIG_LOG_BACKEND_UART=y
CONFIG_LOG_OUTPUT=y
CONFIG_LOG_CUSTOM_FORMAT_SUPPORT=y
CONFIG_LOG_BACKEND_UART_OUTPUT_CUSTOM=y
CONFIG_LOG_DEFAULT_LEVEL=3
CONFIG_LOG_BUFFER_SIZE=1024
# Application module level; see Kconfig.
CONFIG_ZDEMO_LOG_LEVEL=3

# ZGEN-004: fatal errors reset the board.
CONFIG_REBOOT=y

# ZGEN-005: reset cause through hwinfo.
CONFIG_HWINFO=y

# ZBT-006 / ZFN-004: Zephyr flash API for the CONFIRMED record.
CONFIG_FLASH=y

# ZRT-004 / ZFN-004: IWDG through the watchdog API.
CONFIG_WATCHDOG=y

# ZLNK-002: Zephyr CRC32-ISO-HDLC.
CONFIG_CRC=y

# ZRT-005: high-water marks for Status.
CONFIG_THREAD_MONITOR=y
CONFIG_INIT_STACKS=y
CONFIG_THREAD_STACK_INFO=y
CONFIG_THREAD_NAME=y

# Heap statistics for Status (the application itself does not allocate).

# Keep the main thread small; all work is in the static application threads.
CONFIG_MAIN_STACK_SIZE=2048
CONFIG_BOOT_BANNER=n
```

## src/main.c
```c
/**
 * @file    main.c
 * @brief   Zephyr demo application entry point.
 * @details The four application threads (Health, Comms, Button, LED) are
 *          statically defined; main() runs the reset-safe start-up sequence and
 *          returns.
 * @author  Sandesh Ghimire <sandesh@soccentric.com>
 * @date    2026-11-03
 * @target  NUCLEO-F767ZI (Zephyr board nucleo_f767zi), started by BOOT
 * @srs     SRS-ZEPHYR-F767: ZBT-001..005, ZGEN-003..005, ZRT-001..006,
 *          ZFN-001..005, ZSAFE-001..004
 */

#include <soc.h>
#include <zephyr/kernel.h>
#include <zephyr/logging/log.h>

#include "app/zdemo.h"
#include "board/led.h"
#include "boot/boot_contract.h"
#include "boot/handover.h"
#include "comms/uart_hwlink.h"
#include "system/app_fault.h"
#include "system/health.h"
#include "system/iwdg.h"
#include "system/reset_cause.h"

LOG_MODULE_DECLARE(app);

BUILD_ASSERT(CONFIG_FLASH_LOAD_OFFSET == 0xC000,
	     "ZBT-001: the application must be linked at 0x0800C000");
BUILD_ASSERT(CONFIG_FLASH_LOAD_SIZE == 0xF4000,
	     "ZBT-001: the application slot is 976 KB");

/**
 * @brief Report heap usage for Status; always 0/0.
 * @details The application is heapless: flatcc uses a static arena and
 *          malloc/free are not linked.
 *
 * @param[out] free_bytes     Set to 0.
 * @param[out] min_free_bytes Set to 0.
 */
void app_heap_stats(uint32_t *free_bytes, uint32_t *min_free_bytes)
{
	*free_bytes = 0U;
	*min_free_bytes = 0U;
}

/**
 * @brief Run the reset-safe start-up sequence, then return.
 * @details Order: fault boot stamp, watchdog feed, reset cause, hand-over
 *          decode, VTOR check, watchdog install, LD3 latch, USART3 bring-up.
 *          Panics if VTOR is wrong or USART3 cannot start.
 *
 * @return 0.
 */
int main(void)
{
	/* The fault record is in no-init RAM; bump its boot id first. */
	app_fault_boot_start();

	/* ZBT-002/APP-004: feed the BOOT-started watchdog before long init. */
	app_wdt_feed();

	/* ZGEN-005: keep the reset cause for Status, then clear it. */
	app_reset_cause_capture();

	/* ZBT-004: decode the hand-over record before Health starts. */
	app_handover_read();

	/* ZDBG-001: start-up line on the debug UART. */
	LOG_INF("start v%s %s, slot %c %s, reset %s", APP_VERSION_STR,
		APP_GIT_COMMIT,
		g_handover.slot == APP_SLOT_A ? 'A' :
		g_handover.slot == APP_SLOT_B ? 'B' : '?',
		g_handover.trial == 2U ? "on trial" :
		g_handover.trial == 1U ? "confirmed" : "no hand-over",
		app_reset_cause_text);

	/* ZBT-001/ZBT-002: the vector table must be the image's own table. */
	if (SCB->VTOR != (0x08000000UL + CONFIG_FLASH_LOAD_OFFSET)) {
		k_panic();
	}

	(void)app_wdt_init();

	/* LED-005: latch LD3 for the last fault or watchdog reset. */
	if (app_fault_is_valid()) {
		(void)led_post_error(APP_ERROR_FAULT);
		LOG_WRN("last fault recorded before this reset");
	}
	if (app_reset_was_error()) {
		(void)led_post_error(APP_ERROR_WATCHDOG);
	}

	/* COM-001/002: USART3 must be running before the health check. */
	if (!hwlink_uart_init()) {
		k_panic();
	}

	return 0;
}
```

## CMakeLists.txt
```
#
# CMakeLists.txt - HWLINK framing tests on Zephyr's native_sim board
#
# Author:  Sandesh Ghimire <sandesh@soccentric.com>
#
# Build with scripts/test-ztest.sh.  The test links the real application
# hwlink.c, so the CRC and COBS code under test is the code that goes into the
# firmware, not a copy.
#

cmake_minimum_required(VERSION 3.20.0)

find_package(Zephyr REQUIRED HINTS $ENV{ZEPHYR_BASE})
project(hwlink_tests LANGUAGES C)

target_include_directories(app PRIVATE
    "${CMAKE_CURRENT_SOURCE_DIR}/../../src")

target_sources(app PRIVATE
    src/test_hwlink.c
    src/test_led_pattern.c
    "${CMAKE_CURRENT_SOURCE_DIR}/../../src/comms/hwlink.c"
    "${CMAKE_CURRENT_SOURCE_DIR}/../../src/board/led_pattern.c")
```

## prj.conf
```kconfig
# Ztest on native_sim: no hardware, no board overlay, no application threads.
CONFIG_ZTEST=y
CONFIG_CRC=y
CONFIG_MAIN_STACK_SIZE=4096

# Host sanitizers on native_sim: catch buffer overruns and undefined
# behaviour in the framing and pattern code without a board.
CONFIG_ASAN=y
CONFIG_UBSAN=y
```

## src/test_hwlink.c
```c
/*
 * test_hwlink.c - HWLINK framing tests on Zephyr native_sim
 *
 * Author:  Sandesh Ghimire <sandesh@soccentric.com>
 * Target:  native_sim (host), also usable under twister
 *
 * The suite links the application's src/comms/hwlink.c, so the COBS and CRC
 * code paths are the ones the firmware runs.  Zephyr supplies crc32_ieee(),
 * which is the same CRC-32/ISO-HDLC the linker script and BOOT use.
 */

#include <string.h>
#include <zephyr/sys/crc.h>
#include <zephyr/ztest.h>

#include "comms/hwlink.h"

static void roundtrip(const uint8_t *payload, size_t len)
{
	uint8_t raw[HWLINK_MAX_FRAME];
	uint8_t encoded[HWLINK_MAX_ENCODED];
	uint8_t decoded[HWLINK_MAX_FRAME];
	uint8_t out[HWLINK_MAX_FRAME];
	size_t raw_len = 0U;
	size_t encoded_len = 0U;
	size_t decoded_len = 0U;
	size_t out_len = 0U;
	uint8_t flags = 0U;
	uint16_t seq = 0U;

	zassert_true(hwlink_build_raw(payload, len, HWLINK_FLAG_RESPONSE,
				      0x1234U, raw, sizeof(raw), &raw_len),
		     "build_raw failed");
	zassert_equal(raw_len, 8U + len, "raw length");
	zassert_equal(raw[0], HWLINK_PROTOCOL_MAJOR, "proto byte");
	zassert_equal(raw[1], HWLINK_FLAG_RESPONSE, "flags byte");
	zassert_equal(raw[2], 0x34U, "seq low byte");
	zassert_equal(raw[3], 0x12U, "seq high byte");

	zassert_true(hwlink_cobs_encode(raw, raw_len, encoded,
					sizeof(encoded), &encoded_len),
		     "cobs_encode failed");
	zassert_equal(encoded[encoded_len - 1U], 0U, "delimiter");
	for (size_t i = 0U; i < encoded_len - 1U; i++) {
		zassert_not_equal(encoded[i], 0U, "embedded zero at %zu", i);
	}

	zassert_equal(hwlink_cobs_decode(encoded, encoded_len - 1U, decoded,
					 sizeof(decoded), &decoded_len),
		      0, "cobs_decode failed");
	zassert_equal(decoded_len, raw_len, "decoded length");
	zassert_mem_equal(decoded, raw, raw_len, "decoded frame");

	zassert_true(hwlink_decode_raw(decoded, decoded_len, out, sizeof(out),
				       &out_len, &flags, &seq),
		     "decode_raw failed");
	zassert_equal(out_len, len, "payload length");
	zassert_equal(flags, HWLINK_FLAG_RESPONSE, "decoded flags");
	zassert_equal(seq, 0x1234U, "decoded seq");
	zassert_mem_equal(out, payload, len, "payload");
}

ZTEST(hwlink, test_crc_vector)
{
	zassert_equal(crc32_ieee((const uint8_t *)"123456789", 9U),
		      0xCBF43926UL, "CRC-32/ISO-HDLC check value");
}

ZTEST(hwlink, test_roundtrip)
{
	static const uint8_t payload[] = {0x00, 0x01, 0x02, 0xFE, 0xFF, 0x00};

	roundtrip((const uint8_t *)"", 0U);
	roundtrip(payload, sizeof(payload));
}

ZTEST(hwlink, test_cobs_examples)
{
	static const uint8_t zero[] = {0x00};
	static const uint8_t spread[] = {0x01, 0x00, 0x02};
	uint8_t buf[16];
	size_t n = 0U;

	zassert_true(hwlink_cobs_encode(zero, sizeof(zero), buf, sizeof(buf),
					&n), "encode zero");
	zassert_equal(n, 3U, "encoded zero length");
	zassert_equal(buf[0], 0x01U, "code byte");
	zassert_equal(buf[1], 0x01U, "implicit zero block");
	zassert_equal(buf[2], 0x00U, "delimiter");

	zassert_true(hwlink_cobs_encode(spread, sizeof(spread), buf, sizeof(buf),
					&n), "encode spread");
	zassert_equal(n, 5U, "encoded spread length");
	zassert_equal(buf[0], 0x02U, "first code");
	zassert_equal(buf[2], 0x02U, "second code");
}

ZTEST(hwlink, test_cobs_boundaries)
{
	uint8_t big[HWLINK_MAX_FRAME];
	uint8_t encoded[HWLINK_MAX_ENCODED];
	uint8_t decoded[HWLINK_MAX_FRAME];
	size_t encoded_len = 0U;
	size_t decoded_len = 0U;

	for (size_t len = 253U; len <= 255U; len++) {
		memset(big, 0x5A, len);
		zassert_true(hwlink_cobs_encode(big, len, encoded,
						sizeof(encoded), &encoded_len),
			     "encode %zu bytes", len);
		zassert_equal(encoded[encoded_len - 1U], 0U, "delimiter");
		zassert_equal(hwlink_cobs_decode(encoded, encoded_len - 1U,
						 decoded, sizeof(decoded),
						 &decoded_len),
			      0, "decode %zu bytes", len);
		zassert_equal(decoded_len, len, "decoded length");
		zassert_mem_equal(decoded, big, len, "decoded bytes");
	}
}

ZTEST(hwlink, test_rejects_bad_frames)
{
	uint8_t raw[HWLINK_MAX_FRAME];
	uint8_t out[8];
	uint8_t flags = 0U;
	uint16_t seq = 0U;
	size_t raw_len = 0U;
	size_t out_len = 0U;
	static const uint8_t payload[] = {0x01, 0x02, 0x03};

	zassert_equal(hwlink_cobs_decode((const uint8_t *)"\x00", 1U, out,
					 sizeof(out), &out_len),
		      -1, "embedded zero code");
	zassert_equal(hwlink_cobs_decode((const uint8_t *)"\x03\x01", 2U, out,
					 sizeof(out), &out_len),
		      -1, "truncated block");

	zassert_true(hwlink_build_raw(payload, sizeof(payload), 0U, 7U, raw,
				      sizeof(raw), &raw_len), "build frame");
	raw[raw_len - 1U] ^= 0xFFU;
	out_len = 0xDEADBEEFU;
	zassert_false(hwlink_decode_raw(raw, raw_len, out, sizeof(out),
					&out_len, &flags, &seq),
		      "bad CRC accepted");
	zassert_equal(out_len, 0xDEADBEEFU, "out_len changed on failure");

	zassert_true(hwlink_build_raw(payload, sizeof(payload), 0x04U, 7U, raw,
				      sizeof(raw), &raw_len), "build flags");
	zassert_false(hwlink_decode_raw(raw, raw_len, out, sizeof(out),
					&out_len, &flags, &seq),
		      "reserved flag accepted");
}

ZTEST_SUITE(hwlink, NULL, NULL, NULL, NULL, NULL);
```

## src/test_led_pattern.c
```c
/*
 * test_led_pattern.c - LED pattern engine tests on native_sim
 *
 * Author:  Sandesh Ghimire <sandesh@soccentric.com>
 * Target:  native_sim
 *
 * The suite links the application's src/board/led_pattern.c, so the segment
 * tables and phase boundaries are the ones the firmware runs.
 */

#include <zephyr/ztest.h>

#include "app/zdemo.h"
#include "board/led_pattern.h"

static uint32_t total(const uint16_t dur[LED_PATTERN_MAX_SEGMENTS], uint32_t n)
{
	uint32_t sum = 0U;

	for (uint32_t i = 0U; i < n; i++) {
		sum += dur[i];
	}
	return sum;
}

ZTEST(led_pattern, test_next_wraps)
{
	zassert_equal(led_pattern_next(APP_PATTERN_OFF), APP_PATTERN_ON);
	zassert_equal(led_pattern_next(APP_PATTERN_CHASE), APP_PATTERN_MORSE_SOS);
	zassert_equal(led_pattern_next(APP_PATTERN_MORSE_SOS), APP_PATTERN_OFF);
	zassert_equal(led_pattern_next(APP_PATTERN_COUNT), APP_PATTERN_ON);
}

ZTEST(led_pattern, test_segment_tables)
{
	uint16_t dur[LED_PATTERN_MAX_SEGMENTS];
	bool on[LED_PATTERN_MAX_SEGMENTS];
	led_cfg_t cfg = {.pattern = APP_PATTERN_OFF, .period = 1000U, .start = 0U};
	uint32_t n;

	zassert_equal(led_pattern_segments(&cfg, false, dur, on), 0U, "OFF");

	cfg.pattern = APP_PATTERN_ON;
	n = led_pattern_segments(&cfg, false, dur, on);
	zassert_equal(n, 1U, "ON segments");
	zassert_equal(dur[0], 0xFFFFU, "ON duration");
	zassert_true(on[0], "ON level");

	cfg.pattern = APP_PATTERN_BLINK;
	n = led_pattern_segments(&cfg, false, dur, on);
	zassert_equal(n, 2U, "BLINK segments");
	zassert_equal(dur[0], 500U, "BLINK on");
	zassert_equal(dur[1], 500U, "BLINK off");
	zassert_equal(total(dur, n), 1000U, "BLINK cycle");

	cfg.pattern = APP_PATTERN_HEARTBEAT;
	n = led_pattern_segments(&cfg, false, dur, on);
	zassert_equal(n, 4U, "HEARTBEAT segments");
	zassert_equal(dur[0], 50U, "heartbeat on 1");
	zassert_equal(dur[1], 150U, "heartbeat gap");
	zassert_equal(dur[2], 50U, "heartbeat on 2");
	zassert_equal(dur[3], 750U, "heartbeat rest");

	cfg.pattern = APP_PATTERN_MORSE_SOS;
	n = led_pattern_segments(&cfg, false, dur, on);
	zassert_equal(n, 18U, "SOS segments");
	zassert_equal(total(dur, n), 3400U, "SOS cycle");
}

ZTEST(led_pattern, test_chase_pair)
{
	uint16_t dur[LED_PATTERN_MAX_SEGMENTS];
	bool on[LED_PATTERN_MAX_SEGMENTS];
	led_cfg_t cfg = {.pattern = APP_PATTERN_CHASE, .period = 1000U, .start = 0U};
	bool level;
	uint32_t next;
	uint32_t n;

	n = led_pattern_segments(&cfg, false, dur, on);
	zassert_equal(n, 2U, "chase segments");
	zassert_true(on[0], "LD1 first half");
	zassert_false(on[1], "LD1 second half");

	n = led_pattern_segments(&cfg, true, dur, on);
	zassert_equal(n, 2U, "chase pair segments");
	zassert_false(on[0], "LD2 first half");
	zassert_true(on[1], "LD2 second half");

	led_pattern_evaluate(&cfg, false, 0U, &level, &next);
	zassert_true(level, "LD1 on at 0");
	led_pattern_evaluate(&cfg, true, 0U, &level, &next);
	zassert_false(level, "LD2 off at 0");
	led_pattern_evaluate(&cfg, false, 500U, &level, &next);
	zassert_false(level, "LD1 off at 500");
	led_pattern_evaluate(&cfg, true, 500U, &level, &next);
	zassert_true(level, "LD2 on at 500");
}

ZTEST(led_pattern, test_phase_boundaries)
{
	led_cfg_t cfg = {.pattern = APP_PATTERN_BLINK, .period = 1000U, .start = 0U};
	bool level;
	uint32_t next;

	led_pattern_evaluate(&cfg, false, 0U, &level, &next);
	zassert_true(level, "on at 0");
	zassert_equal(next, 500U, "next edge at 500");

	led_pattern_evaluate(&cfg, false, 499U, &level, &next);
	zassert_true(level, "still on at 499");
	zassert_equal(next, 1U, "one tick to the edge");

	led_pattern_evaluate(&cfg, false, 500U, &level, &next);
	zassert_false(level, "off at 500");
	zassert_equal(next, 500U, "next edge at 1000");

	led_pattern_evaluate(&cfg, false, 1000U, &level, &next);
	zassert_true(level, "wrapped to on");

	cfg.pattern = APP_PATTERN_OFF;
	led_pattern_evaluate(&cfg, false, 0U, &level, &next);
	zassert_false(level, "OFF level");
	zassert_equal(next, LED_PATTERN_NO_TRANSITION, "OFF has no transition");

	cfg.pattern = APP_PATTERN_ON;
	led_pattern_evaluate(&cfg, false, 0U, &level, &next);
	zassert_true(level, "ON level");
	zassert_equal(next, LED_PATTERN_NO_TRANSITION, "ON has no transition");

	/* Unsigned delta: phase still correct across the 32-bit wrap. */
	cfg.pattern = APP_PATTERN_BLINK;
	cfg.start = 0xFFFFFF00UL;
	led_pattern_evaluate(&cfg, false, 0x00000010UL, &level, &next);
	zassert_true(level, "on after wrap");
	zassert_equal(next, 228U, "phase after wrap");
}

ZTEST_SUITE(led_pattern, NULL, NULL, NULL, NULL, NULL);
```
